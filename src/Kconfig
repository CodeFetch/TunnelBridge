## src/Kconfig
```kconfig
config TUNNELBRIDGE
	tristate "IP: TunnelBridge encrypted layer 2 tunnel"
	depends on NET && INET
	depends on IPV6 || !IPV6
	select NET_UDP_TUNNEL
	select DST_CACHE
	select CRYPTO_BLKCIPHER
	select VFP
	select VFPv3 if CPU_V7
	select NEON if CPU_V7
	select KERNEL_MODE_NEON if CPU_V7
	default m
	help
	  TunnelBridge is an encrypted layer 2 tunnel which supports
	  multiple peers while working similar to a bridge.

	  It's safe to say Y or M here, as the driver is very lightweight and
	  is only in use when an administrator chooses to add an interface.

config TUNNELBRIDGE_DEBUG
	bool "Debugging checks and verbose messages"
	depends on TUNNELBRIDGE
	help
	  This will write log messages for handshake and other events
	  that occur for a TunnelBridge interface. It will also perform some
	  extra validation checks and unit tests at various points. This is
	  only useful for debugging.

	  Say N here unless you know what you're doing.
```
